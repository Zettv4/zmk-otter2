## boards/shields/otter/Kconfig.defconfig
```kconfig
if SHIELD_OTTER_LEFT

# Name must be less than 16 characters long!
config ZMK_KEYBOARD_NAME
    default "otter"

config ZMK_SPLIT_ROLE_CENTRAL
    default y

endif

if SHIELD_OTTER_LEFT || SHIELD_OTTER_RIGHT

config ZMK_SPLIT
    default y

endif

if SHIELD_OTTER_DONGLE

# Name must be less than 16 characters long!
config ZMK_KEYBOARD_NAME
    default "otter"

config ZMK_SPLIT
    default y

config ZMK_SPLIT_ROLE_CENTRAL
    default y

config ZMK_SPLIT_BLE_CENTRAL_PERIPHERALS
    default 2

config BT_MAX_CONN
    default 7

config BT_MAX_PAIRED
    default 7

endif
```

## boards/shields/otter/Kconfig.shield
```kconfig
config SHIELD_OTTER_LEFT
    def_bool $(shields_list_contains,otter_left)

config SHIELD_OTTER_RIGHT
    def_bool $(shields_list_contains,otter_right)

config SHIELD_OTTER_DONGLE
    def_bool $(shields_list_contains,otter_dongle)
```
